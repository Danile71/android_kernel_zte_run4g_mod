global &project
&project="mt6752_evb_atf"
